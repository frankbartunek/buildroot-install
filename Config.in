## Config.in
```kconfig
source "/usr/src/buildroot-install/rpm/Config.in"
source "/usr/src/buildroot-install/yumbootstrap/Config.in"
source "/usr/src/buildroot-install/debootstrap/Config.in"
source "/usr/src/buildroot-install/kilo/Config.in"
source "/usr/src/buildroot-install/dpkg/Config.in"
```

## debootstrap/Config.in
```kconfig
config BR_PACKAGE_DEBOOTSTRAP
	bool "debootstrap"
	help
		Debootstrap establishes a new dpkg-based system.
```

## dpkg/Config.in
```kconfig
config BR_PACKAGE_DPKG
	bool "dpkg"
	help
		The Debian package manager, needed to bootstrap Debian systems.
```

## kilo/Config.in
```kconfig
config BR_PACKAGE_KILO
	bool "kilo"
	help
		Kilo is a small editor written by antirez.   This is a patched
		version that should meet the needs of embedded systems.
```

## yumbootstrap/Config.in
```kconfig
config BR_PACKAGE_YUMBOOTSTRAP
	bool "yumbootstrap"
	help
		Yumbootstrap allows the rapid setup of RPM based distros.
```
